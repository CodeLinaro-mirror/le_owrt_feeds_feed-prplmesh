## services/mod-whm-wifimapper/Config.in
```kconfig
config PACKAGE_mod-whm-wifimapper
    bool "mod-whm-wifimapper"
    depends on PACKAGE_pwhm
    default y
```

## services/prplmesh-dm-mapper/Config.in
```kconfig
menu "Select DataModel Mapper build options"
    depends on PACKAGE_prplmesh-dm-mapper

config PRPLMESH_DM_MAPPER_START_ORDER
    int "prplmesh-dm-mapper start up order"
    default 99

config PRPLMESH_DM_MAPPER_STOP_ORDER
    int "prplmesh-dm-mapper stop order"
    default 0

endmenu
```

## services/prplmesh-process-manager/Config.in
```kconfig
menu "Select prplmesh-process-manager build options"
    depends on PACKAGE_prplmesh-process-manager

config PRPLMESH_PROCESS_MANAGER_START_ORDER
    int "prplmesh-process-manager start up order"
    default 99

config PRPLMESH_PROCESS_MANAGER_STOP_ORDER
    int "prplmesh-process-manager stop order"
    default 0

endmenu
```

## services/wifi-scheduler/Config.in
```kconfig
config PACKAGE_wifi-scheduler
    tristate
    select SAH_SERVICES_WIFI-SCHEDULER

if PACKAGE_wifi-scheduler

menu "Select wifi-scheduler build options"
    depends on PACKAGE_wifi-scheduler

config SAH_SERVICES_WIFI-SCHEDULER
    bool "Service for Week-based WiFi enabling"
    default y

config SAH_SERVICES_WIFI-SCHEDULER_START_ORDER
    int "Start up order"
    default 99

config SAH_SERVICES_WIFI-SCHEDULER_STOP_ORDER
    int "Stop order"
    default 1

endmenu

endif
```

## services/wifi-sensing/Config.in
```kconfig
config PACKAGE_wifi-sensing
    tristate
    select SAH_SERVICES_SENSING

if PACKAGE_wifi-sensing

menu "Select wifi-sensing build options"
    depends on PACKAGE_wifi-sensing

config SAH_SERVICES_SENSING
    bool "Build wifi sensing itself"
    default y

config SAH_SERVICES_SENSING_START_ORDER
    int "Start up order"
    default 120

config SAH_SERVICES_SENSING_STOP_ORDER
    int "Stop order"
    default 1

endmenu

endif
```
