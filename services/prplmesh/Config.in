## services/prplmesh/Config.in
```kconfig
config PRPLMESH_HAS_WIRELESS_STA
    bool "Include wireless STA support (intel_mips platforms)"
    depends on TARGET_intel_mips || TARGET_intel_x86
    select WIRELESS_STA
    default y
    help
        Include wireless STA support.
        For intel_mips platforms, leave this option enabled  to have wireless station support.
        For other platforms, the wireless station support is included by default and cannot be disabled.

config USE_PRPLMESH_WHM
    bool "Use prplMesh Wireless Hardware Manager"
    default n

config PRPLMESH_ENABLE_AMBIORIX_UBUS_BACKEND
    bool "Enable usage of Ambiorix ubus backend"
    default y

config PRPLMESH_ENABLE_UNIT_TESTS
    bool "Enable build of unit tests"

config PRPL_CONTROLLER_ROOT_PATH
    string "Default prplmesh Datamodel path"
    default "X_PRPLWARE-COM_WiFiController"
    depends on PACKAGE_prplmesh
    help
        Set the root datamodel to be used, by default will be set to X_PRPLWARE-COM_WiFiController, unless if any project changes
        it to something else.
        This may be helpful when several third-party packages have something in Device.WiFi.

config PRPLMESH_BML
    bool "Build the BML management interface"
    default y if !PRPLMESH_ENABLE_AMBIORIX_UBUS_BACKEND
    default n
    help
        Builds the BML management interface: libbml, the controller-side
        handlers and listener task, and the BML and CLI codecs. Nothing in
        the runtime uses it; enable it for the BML SDK, for beerocks_cli
        (PRPLMESH_BEEROCKS_CLI), or for pre-association steering on ugw
        and rdkb.

        Defaults to y when PRPLMESH_ENABLE_AMBIORIX_UBUS_BACKEND is off,
        since prplMesh refuses a controller with no management interface.

config PRPLMESH_CLI
    bool "Build the prplmesh_cli diagnostic tool"
    default y
    depends on PRPLMESH_ENABLE_AMBIORIX_UBUS_BACKEND
    help
        Builds prplmesh_cli, the diagnostic tool that reads the TR-181 data
        model. The cram tests and the boardfarm harness read the connection
        map through it. Requires PRPLMESH_ENABLE_AMBIORIX_UBUS_BACKEND.

config PRPLMESH_BEEROCKS_CLI
    bool "Build the beerocks_cli diagnostic tool"
    default n
    depends on PRPLMESH_BML
    help
        Builds beerocks_cli, the diagnostic tool that drives the BML
        interface. Requires PRPLMESH_BML. Enable it for manual diagnostics
        or for the boardfarm tests that drive "beerocks_cli -c <command>".

config PRPLMESH_VENDOR_EXTENSIONS
    bool "Build vendor-specific TLV extensions (Airties)"
    default n
    help
        Builds libmulti_vendor and the beerocks_vendor_message daemon,
        roughly 150 KB (x86_64 musl). Enable it on products managed by an
        Airties controller. When off, no Airties TLV is added to outgoing
        messages and inbound Airties requests (reboot, factory reset) are
        not acted on; generic vendor TLV parsing is unaffected.

config PRPLMESH_FLASH_OPTIMIZATION
    bool "Optimize prplMesh for flash footprint"
    default n
    help
        Builds prplMesh with FLASH_OPTIMIZATION=ON: the generated TLV
        codecs log through an out-of-line sink and share their guard
        code, easylogging's stream operators are defined once in
        libelpp, and the tree is built without unwind tables and with
        unreachable sections dropped. libtlvf and libbtlvf are roughly
        half their default size.

        Trade-offs: codec log lines report tlvflogging.cpp instead of
        their own file and line, print doubles through std::to_string
        and drop std::endl; the generated init() symbols are hidden;
        and without unwind tables no backtrace can be produced.
```
